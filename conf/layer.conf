## conf/layer.conf
```bitbake
# We have a conf and classes directory, add to BBPATH
BBPATH .= ":${LAYERDIR}"

# We have recipes-* directories, add to BBFILES
BBFILES += "${LAYERDIR}/recipes-*/*/*.bb \
            ${LAYERDIR}/recipes-*/*/*.bbappend"

BBFILE_COLLECTIONS += "meta-edgeplant"
BBFILE_PATTERN_meta-edgeplant = "^${LAYERDIR}/"

LAYERDEPENDS_meta-edgeplant = "core tegra"
LAYERSERIES_COMPAT_meta-edgeplant = "kirkstone"
```

## conf/machine/jasmine.conf
```bitbake
require conf/machine/jetson-tx2-devkit-4gb.conf

MACHINE_EXTRA_RRECOMMENDS += "linux-firmware"
MACHINE_ESSENTIAL_EXTRA_RDEPENDS += "tegra-nvpmodel tegra-tools edgeplant-l4t-tools"

# from tegra186.inc and tegra-common.inc
MACHINE_FEATURES += "keyboard serial"

# eMMC size for Jetson TX2 4GB
IMAGE_ROOTFS_SIZE ??= "13631488"

# Fix partition size
RECROOTFSSIZE = "104857600"

KERNEL_DEVICETREE = "_ddot_/_ddot_/_ddot_/_ddot_/aptpod/board/jasmine/kernel-dts/tegra186-aptpod-jb01-jasmine.dtb"

# Serial Console for UART1
SERIAL_CONSOLES = "115200;ttyS2"
KERNEL_ARGS = "console=ttyS2,115200 console=tty0 fbcon=map:0 isolcpus="

IMAGE_CLASSES += "image_types_tegra"
IMAGE_FSTYPES = "tegraflash"
TEGRAFLASH_PACKAGE_FORMAT = "zip"

TEGRA_AUDIO_DEVICE = "tegrasndt186ref"

# UPHY setting for Jasmine
ODMDATA = "0x7090000"

# do not use initrd flash (external device boot)
# https://github.com/OE4T/meta-tegra/pull/1140
# https://github.com/OE4T/meta-tegra/wiki/initrd-flashing-support
TEGRAFLASH_INITRD_FLASH_IMAGE = ""
```

## recipes-kernel/linux/linux-tegra/jasmine/aptpod/sound/soc/Kconfig
```kconfig
if SND_SOC

source "sound/soc/codecs/Kconfig"
source "sound/soc/tegra/Kconfig"

endif
```

## recipes-kernel/linux/linux-tegra/jasmine/aptpod/sound/soc/codecs/Kconfig
```kconfig
if SND_SOC

config SND_SOC_JB01_MAX9867
	tristate "Maxim MAX9867 CODEC on JB01 board"
	depends on I2C

endif
```

## recipes-kernel/linux/linux-tegra/jasmine/aptpod/sound/soc/tegra/Kconfig
```kconfig
if SND_SOC

config SND_SOC_TEGRA186_JB01_ALT
	tristate "Soc Audio support for JB01 with MAX9867"
	depends on I2C
	depends on ARCH_TEGRA_210_SOC || ARCH_TEGRA_18x_SOC
	select SND_SOC_TEGRA210_XBAR_ALT
	select SND_SOC_TEGRA210_PCM_ALT
	select SND_SOC_TEGRA210_ADMA_ALT
	select SND_SOC_TEGRA210_ADMAIF_ALT
	select SND_SOC_TEGRA210_I2S_ALT
	select SND_SOC_TEGRA210_DMIC_ALT
	select SND_SOC_TEGRA210_AMX_ALT
	select SND_SOC_TEGRA210_ADX_ALT
	select SND_SOC_TEGRA210_MIXER_ALT
	select SND_SOC_TEGRA210_SFC_ALT
	select SND_SOC_TEGRA210_AFC_ALT
	select SND_SOC_TEGRA210_MVC_ALT
	select SND_SOC_TEGRA210_OPE_ALT
	select SND_SOC_TEGRA210_ADSP_ALT if TEGRA_NVADSP && !DISABLE_ADSP_AUDIO
	select SND_SOC_TEGRA186_ASRC_ALT if ARCH_TEGRA_18x_SOC
	select SND_SOC_TEGRA186_ARAD_ALT if ARCH_TEGRA_18x_SOC
	select SND_SOC_TEGRA186_DSPK_ALT if ARCH_TEGRA_18x_SOC
	select SND_SOC_SPDIF
	select SND_SOC_COMPRESS
	select SND_SOC_RT5640
	select SND_SOC_RT5659
	select SND_SOC_SGTL5000
	select SND_SOC_MAX9867_JB01
    help
	  Say Y or M here.

endif
```
