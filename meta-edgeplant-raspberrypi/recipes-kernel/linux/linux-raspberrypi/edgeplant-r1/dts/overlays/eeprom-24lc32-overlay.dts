// Enable EEPROM
/dts-v1/;
/plugin/;

/ {
    compatible = "brcm,bcm2835";

    fragment@0 {
        target = <&i2c0>;
        __overlay__ {
            #address-cells = <1>;
            #size-cells = <0>;
            status = "okay";

            eeprom: eeprom@50 {
                compatible = "microchip,24lc32","atmel,24c32";
                reg = <0x50>;
                pagesize = <32>;
            };
        };
    };
};
